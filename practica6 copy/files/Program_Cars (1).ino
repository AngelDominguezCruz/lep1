#include <Servo.h>
#include "U8glib.h"
//---------------------------PINES ASIGNADOS---------------------------------------
//PANTALLA OLED--------
U8GLIB_SSD1306_128X64 u8g(U8G_I2C_OPT_DEV_0 | U8G_I2C_OPT_NO_ACK | U8G_I2C_OPT_FAST); // Fast I2C / TWI
// U8GLIB_SSD1306_128X64 u8g(13, 11, 8, 9, 10); // SPI connection
// for SPI connection, use this wiring:
// GND > GND
// VCC > 5V
// SCL > 13
// SDA > 11
// RES > 10
// DC > 9
// CS > 8



// all the arrays below are generated from images using image2cpp website
// scroll down to see the actual code


//ICONOS-----------------------------------------------------------------
  // 'icon_led', 16x16px
  const unsigned char epd_bitmap_icon_led [] PROGMEM = {
    0x44, 0x22, 0x24, 0x24, 0x22, 0x44, 0x10, 0x08, 0x83, 0xc1, 0x46, 0x22, 0x2c, 0x14, 0x0c, 0x10, 
    0x0c, 0x10, 0xec, 0x17, 0x08, 0x10, 0x08, 0x10, 0x27, 0xf4, 0x42, 0x22, 0x82, 0x21, 0x02, 0x20
  };
  // 'icon_motor', 16x16px
  const unsigned char epd_bitmap_icon_motor [] PROGMEM = {
    0x00, 0x00, 0x00, 0x00, 0x07, 0xf0, 0x00, 0x00, 0x03, 0xe0, 0x3f, 0xf0, 0xb8, 0x08, 0xb0, 0x05, 
    0xf0, 0x05, 0xb0, 0x07, 0xb0, 0x07, 0x30, 0x05, 0x18, 0x05, 0x0f, 0xfc, 0x00, 0x00, 0x00, 0x00
  };
  // 'icon_sensor', 16x16px
  const unsigned char epd_bitmap_icon_sensor [] PROGMEM = {
    0x0f, 0xf0, 0x30, 0x0c, 0x40, 0x02, 0x87, 0xe1, 0x18, 0x18, 0x20, 0x04, 0x03, 0xc0, 0x04, 0x20, 
    0x00, 0x00, 0x3e, 0x7c, 0x22, 0x44, 0x22, 0x44, 0x22, 0x44, 0x7f, 0xfe, 0x7f, 0xfe, 0x00, 0x00
  };
  // 'icon_servo', 16x16px
  const unsigned char epd_bitmap_icon_servo [] PROGMEM = {
    0x00, 0x00, 0x00, 0x00, 0x07, 0xff, 0x03, 0xc0, 0x1f, 0xf8, 0x7f, 0xfe, 0x78, 0x0e, 0x18, 0x08, 
    0x18, 0x08, 0x18, 0x08, 0x18, 0x08, 0x18, 0x08, 0x18, 0x08, 0x0f, 0xf8, 0x00, 0x00, 0x00, 0x00
  };
  // Array of all bitmaps for convenience. (Total bytes used to store images in PROGMEM = 192)
  const int epd_bitmap_allArray_LEN = 4;
  const unsigned char* epd_bitmap_icon[4] = {
    epd_bitmap_icon_led,
    epd_bitmap_icon_motor,
    epd_bitmap_icon_sensor,
    epd_bitmap_icon_servo
  };
//SEGUNDA PANTALLA-----------------------------------------------------------------
// 'scrollbar_background', 8x64px
const unsigned char bitmap_scrollbar_background [] PROGMEM = {
  0x00, 0x02, 0x00, 0x02, 0x00, 0x02, 0x00, 0x02, 0x00, 0x02, 0x00, 0x02, 0x00, 0x02, 0x00, 0x02, 
  0x00, 0x02, 0x00, 0x02, 0x00, 0x02, 0x00, 0x02, 0x00, 0x02, 0x00, 0x02, 0x00, 0x02, 0x00, 0x02, 
  0x00, 0x02, 0x00, 0x02, 0x00, 0x02, 0x00, 0x02, 0x00, 0x02, 0x00, 0x02, 0x00, 0x02, 0x00, 0x02, 
  0x00, 0x02, 0x00, 0x02, 0x00, 0x02, 0x00, 0x02, 0x00, 0x02, 0x00, 0x02, 0x00, 0x02, 0x00, 0x00
};
// 'screenshot_3dcube', 128x64px
const unsigned char bitmap_screenshot_3dcube [] PROGMEM = {
  0x00, 0x00, 0x00, 0x00, 0x00, 0x00, 0x00, 0x00, 0x00, 0x00, 0x00, 0x00, 0x00, 0x00, 0x15, 0xd7, 
  0x00, 0x00, 0x00, 0x00, 0x00, 0x00, 0x00, 0x00, 0x00, 0x00, 0x00, 0x00, 0x00, 0x00, 0x15, 0x45, 
  0x00, 0x00, 0x00, 0x00, 0x00, 0x00, 0x00, 0x00, 0x00, 0x00, 0x00, 0x00, 0x00, 0x00, 0x15, 0x96, 
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  0x00, 0x00, 0x00, 0x00, 0x00, 0x00, 0x00, 0x00, 0x00, 0x00, 0x00, 0x00, 0x00, 0x00, 0x00, 0x00
};
// 'screenshot_battery', 128x64px
const unsigned char bitmap_screenshot_battery [] PROGMEM = {
  0x00, 0x00, 0x00, 0x00, 0x00, 0x00, 0x00, 0x00, 0x00, 0x00, 0x00, 0x00, 0x00, 0x00, 0x00, 0x00, 
  0x00, 0x00, 0x00, 0x00, 0x00, 0x00, 0x00, 0x00, 0x00, 0x00, 0x00, 0x00, 0x00, 0x00, 0x00, 0x00, 
  0x00, 0x00, 0x00, 0x00, 0x00, 0x00, 0x00, 0x00, 0x00, 0x00, 0x00, 0x00, 0x00, 0x00, 0x00, 0x00, 
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  0x00, 0x00, 0x00, 0x00, 0x00, 0x00, 0x00, 0x00, 0x00, 0x00, 0x00, 0x00, 0x00, 0x00, 0x19, 0x15
};
// 'screenshot_fireworks', 128x64px
const unsigned char bitmap_screenshot_fireworks [] PROGMEM = {
  0x00, 0x00, 0x00, 0x00, 0x00, 0x00, 0x00, 0x00, 0x00, 0x00, 0x00, 0x00, 0x00, 0x00, 0x00, 0x00, 
  0x08, 0x00, 0x00, 0x00, 0x00, 0x00, 0x00, 0x00, 0x00, 0x00, 0x00, 0x00, 0x00, 0x00, 0x00, 0x00, 
  0x08, 0x00, 0x00, 0x00, 0x00, 0x00, 0x00, 0x00, 0x00, 0x00, 0x00, 0x00, 0x00, 0x00, 0x00, 0x00, 
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  0x00, 0x00, 0x00, 0x00, 0x00, 0x00, 0x00, 0x00, 0x00, 0x00, 0x00, 0x00, 0x00, 0x00, 0x19, 0x15
};
// 'screenshot_gauges', 128x64px
const unsigned char bitmap_screenshot_gauges [] PROGMEM = {
  0x10, 0x00, 0x00, 0x00, 0x00, 0x01, 0x00, 0x00, 0x00, 0x00, 0x80, 0x00, 0x00, 0x00, 0x00, 0x08, 
  0x30, 0x00, 0x00, 0x00, 0x00, 0x00, 0xc0, 0x00, 0x00, 0x03, 0x00, 0x00, 0x00, 0x00, 0x00, 0x0c, 
  0x7e, 0x00, 0x00, 0x00, 0x00, 0x00, 0x38, 0x00, 0x00, 0x1c, 0x00, 0x00, 0x00, 0x00, 0x00, 0x7e, 
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  0x00, 0x00, 0x00, 0x00, 0x00, 0x01, 0x00, 0x00, 0x00, 0x00, 0x80, 0x00, 0x00, 0x00, 0x19, 0x15
};
// Array of all bitmaps for convenience. (Total bytes used to store images in PROGMEM = 8320)
const unsigned char* bitmap_screenshots[8] = {
  bitmap_screenshot_3dcube,
  bitmap_screenshot_battery,
  bitmap_screenshot_gauges, 
  bitmap_screenshot_fireworks
 };



// 'item_sel_outline', 128x21px
const unsigned char bitmap_item_sel_outline [] PROGMEM = {
  0x1f, 0xff, 0xff, 0xff, 0xff, 0xff, 0xff, 0xff, 0xff, 0xff, 0xff, 0xff, 0xff, 0xff, 0xff, 0xc0, 
  0x20, 0x00, 0x00, 0x00, 0x00, 0x00, 0x00, 0x00, 0x00, 0x00, 0x00, 0x00, 0x00, 0x00, 0x00, 0x20, 
  0x40, 0x00, 0x00, 0x00, 0x00, 0x00, 0x00, 0x00, 0x00, 0x00, 0x00, 0x00, 0x00, 0x00, 0x00, 0x30, 
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  0x1f, 0xff, 0xff, 0xff, 0xff, 0xff, 0xff, 0xff, 0xff, 0xff, 0xff, 0xff, 0xff, 0xff, 0xff, 0xc0
};
// ------------------ end generated bitmaps from image2cpp ---------------------------------
const int NUM_ITEMS = 4; // number of items in the list and also the number of screenshots and screenshots with QR codes (other screens)
const int MAX_ITEM_LENGTH = 20; // maximum characters for the item name

char menu_items [NUM_ITEMS] [MAX_ITEM_LENGTH] = {  // array with item names
  { "LEDS" }, // LE PUEDEO CAMBIAR LOS NOMBRES
  { "MOTORES" }, 
  { "SENSOR" }, 
  { "SERVO" }

 };


// note - when changing the order of items above, make sure the other arrays referencing bitmaps
// also have the same order, for example array "bitmap_icons" for icons, and other arrays for screenshots and QR codes

//#define BUTTON_UP_PIN 19 // pin for UP button 
#define BUTTON_SELECT_PIN 2 // pin for SELECT button
//#define BUTTON_DOWN_PIN 22 // pin for DOWN button

//#define DEMO_PIN 13 // pin for demo mode, use switch or wire to enable or disable demo mode, see more details below


int button_up_clicked = 1; // only perform action when button is clicked, and wait until another press
int button_select_clicked = 1; // same as above
int button_down_clicked = 1; // same as above

int item_selected = 0; // which item in the menu is selected

int item_sel_previous; // previous item - used in the menu screen to draw the item before the selected one
int item_sel_next; // next item - used in the menu screen to draw next item after the selected one

int current_screen = 0;   // 0 = menu, 1 = screenshot, 2 = qr

int demo_mode = 0; // when demo mode is set to 1, it automatically goes over all the screens, 0 = control menu with buttons
int demo_mode_state = 0; // demo mode state = which screen and menu item to display
int demo_mode_delay = 0; // demo mode delay = used to slow down the screen switching

//MOTORES--------------
  //derecho
    int pwmD = 6;
    int dirD1 = 13;
    int dirD2 = 15;
  //izquierdo
    int pwmI = 3;    
    int dirI1 = 16;
    int dirI2 = 17;
  //Velocidad
    int vel = 255;

//SERVO------------------
  //pin 5 pwm
  Servo servoMotor;
//LEDS----------------
  //analog
  int led1 = 4; 
  int led2 = 8;
  int led3 = 7;

//BOTONES----------------
  //digital
  //pin 2
  //analog
  int botA1 = A6;
  int botA2 = A7;
  //convercion en digitales
  int BUTTON_UP_PIN=0,BUTTON_DOWN_PIN=0;

//POTENCIOMETRO----------

  int pot = A0;
  int posicion_pot=0;
  int angulo_servo = 0;

//SENSOR-------------------

  int trig = 12;
  int eco = 11;
  int duracion;
  int distancia;

//BUZZER----------------------

  int buzzer_delay = 1000;
  int buzzer_pin = 9;
void setup() {
  Serial.begin(9600);
  //PANTALLA OLED
    u8g.setColorIndex(1);  // set the color to white
    // define pins for buttons
    // INPUT_PULLUP means the button is HIGH when not pressed, and LOW when pressed
    // since it´s connected between some pin and GND
    pinMode(botA1, INPUT_PULLUP); // up button
    pinMode(BUTTON_SELECT_PIN, INPUT_PULLUP); // select button
    pinMode(botA2, INPUT_PULLUP); // down button

    //pinMode(DEMO_PIN, INPUT_PULLUP);
  //MOTORES
    pinMode(pwmD,OUTPUT);
    pinMode(pwmI,OUTPUT);
    pinMode(dirD1,OUTPUT);
    pinMode(dirD2,OUTPUT);
    pinMode(dirI1,OUTPUT);
    pinMode(dirI2,OUTPUT);
  //SERVOMOTOR
    servoMotor.attach(5);
  //LEDS 
    pinMode(led1,OUTPUT);
    pinMode(led2,OUTPUT);
    pinMode(led3,OUTPUT);
  //BOTONES
    pinMode(botA1,INPUT);
    pinMode(botA2,INPUT);
  //POTENCIOMETRO
    pinMode(pot, INPUT);
  //SENSOR
    pinMode(trig, OUTPUT);
    pinMode(eco,INPUT);
  //BUZZER
    pinMode(buzzer_pin,OUTPUT);
}

void loop() {
  botones();
    //DEMO----------------------------------------------------------------------------------------------------------------------------------
      /*if (digitalRead(DEMO_PIN) == LOW) {
        demo_mode = 1; // enable demo mode  
      }
      else  {
        demo_mode = 0; // disable demo mode
      }
      

      if (demo_mode == 1) { // when demo mode is active, automatically switch between all the screens and menu items
      demo_mode_delay++; // increase demo mode delay
      if (demo_mode_delay > 15) { // after some time, switch to another screen - change this value to make it slower/faster
        demo_mode_delay = 0;
        demo_mode_state++; // increase counter
        if (demo_mode_state >= NUM_ITEMS*3) {demo_mode_state=0;} // jump back to the first screen
      }
    
      if (demo_mode_state % 3 == 0) {current_screen = 0; item_selected = demo_mode_state/3; } // menu screen
      else if (demo_mode_state % 3 == 1) {current_screen = 1; item_selected = demo_mode_state/3;} // screenshots screen
      else if (demo_mode_state % 3 == 2) {current_screen = 2; item_selected = demo_mode_state/3;} // qr codes screen

    } // end demo mode section*/

    //MENU------------------------------------------------------------------------------------------------------------------------------------------

      if (current_screen == 0) { // MENU SCREEN

          // up and down buttons only work for the menu screen
          if ((BUTTON_UP_PIN == 0) && (button_up_clicked == 0)) { // up button clicked - jump to previous menu item
            item_selected = item_selected - 1; // select previous item
            button_up_clicked = 1; // set button to clicked to only perform the action once
            if (item_selected < 0) { // if first item was selected, jump to last item
              item_selected = NUM_ITEMS-1;
            }
          }
          else if ((BUTTON_DOWN_PIN == 0) && (button_down_clicked == 0)) { // down button clicked - jump to next menu item
            item_selected = item_selected + 1; // select next item
            button_down_clicked = 1; // set button to clicked to only perform the action once
            if (item_selected >= NUM_ITEMS) { // last item was selected, jump to first menu item
              item_selected = 0;
              }
          } 

          if ((BUTTON_UP_PIN == 1) && (button_up_clicked == 1)) { // unclick 
            button_up_clicked = 0;
          }
          if ((BUTTON_DOWN_PIN == 1) && (button_down_clicked == 1)) { // unclick
            button_down_clicked = 0;
          }

      }


    
    if ((digitalRead(BUTTON_SELECT_PIN) == LOW) && (button_select_clicked == 0)) { // select button clicked, jump between screens
      button_select_clicked = 1; // set button to clicked to only perform the action once
      if (current_screen == 0) {current_screen = 1;} // menu items screen --> screenshots screen
      //else if (current_screen == 1) {current_screen = 2;} // screenshots screen --> qr codes screen
      else {current_screen = 0;} // qr codes screen --> menu items screen
      buzzer();
    }
    if ((digitalRead(BUTTON_SELECT_PIN) == HIGH) && (button_select_clicked == 1)) { // unclick 
      button_select_clicked = 0;
    }

    // set correct values for the previous and next items
    item_sel_previous = item_selected - 1;
    if (item_sel_previous < 0) {item_sel_previous = NUM_ITEMS - 1;} // previous item would be below first = make it the last
    item_sel_next = item_selected + 1;  
    if (item_sel_next >= NUM_ITEMS) {item_sel_next = 0;} // next item would be after last = make it the first


    u8g.firstPage(); // required for page drawing mode for u8g library
    do {

      if (current_screen == 0) { // MENU SCREEN

        // selected item background
        u8g.drawBitmapP(0, 22, 128/8, 21, bitmap_item_sel_outline);

        // draw previous item as icon + label                                 SELECCION DE ARRIBA
        u8g.setFont(u8g_font_7x14);                                           //tamaño de letra
        u8g.drawStr(25, 15, menu_items[item_sel_previous]);                   //nombre de la seleccion
        u8g.drawBitmapP( 4, 2, 16/8, 16, epd_bitmap_icon[item_sel_previous]);    //icono    

        // draw selected item as icon + label in bold font                    SELECCION DE EN MEDIO
        u8g.setFont(u8g_font_7x14B);    
        u8g.drawStr(25, 15+20+2, menu_items[item_selected]);   
        u8g.drawBitmapP( 4, 24, 16/8, 16, epd_bitmap_icon[item_selected]);     

        // draw next item as icon + label                                     SELECCION DE ABAJO
        u8g.setFont(u8g_font_7x14);     
        u8g.drawStr(25, 15+20+20+2+2, menu_items[item_sel_next]);   
        u8g.drawBitmapP( 4, 46, 16/8, 16, epd_bitmap_icon[item_sel_next]);  

        // draw scrollbar background                                          LINEA PUNTEADA DEL SCROLL
        u8g.drawBitmapP(128-8, 0, 8/8, 64, bitmap_scrollbar_background);      

        // draw scrollbar handle                                              INDICADOR DEL SCROLL
        u8g.drawBox(125, 64/NUM_ITEMS * item_selected, 3, 64/NUM_ITEMS); 

        // draw upir logo                                                     LOGO DEL CREADOR
        //u8g.drawBitmapP(128-16-4, 64-4, 16/8, 4, upir_logo);               

      } 
      else if (current_screen == 1) { // IMAGEN 2
          
          //u8g.drawBitmapP( 0, 0, 128/8, 64, bitmap_screenshots[item_selected]); // draw screenshot
          
          
          if(item_selected==0){
            u8g.drawBitmapP( 0, 0, 128/8, 64, bitmap_screenshots[item_selected]);
            
            leds();
           
          }
          else if(item_selected==1){
            u8g.drawBitmapP( 0, 0, 128/8, 64, bitmap_screenshots[item_selected]);
            
            motores();
           
          }
          else if(item_selected==2){
            u8g.drawBitmapP( 0, 0, 128/8, 64, bitmap_screenshots[item_selected]);
            //Serial.println(2);
            sensor();
           
          }
          else if (item_selected==3){
            u8g.drawBitmapP( 0, 0, 128/8, 64, bitmap_screenshots[item_selected]);
            
            servo();
           
          }

          
      }
      else if (current_screen == 2) { // IMAGEN 3 esta desactivada
          
      }   

    } while ( u8g.nextPage() ); // required for page drawing mode with u8g library


  }


  












void buzzer(){
  for(int i = 0; i<30;i++){
  digitalWrite(buzzer_pin,HIGH);
  delayMicroseconds(buzzer_delay);
  digitalWrite(buzzer_pin,LOW);
  delayMicroseconds(buzzer_delay);
  }
  
}

void potenciometro(){
  //x=analogRead(pot);  
  //Serial.println(x);
  delay(100);

}
void botones(){
  if(analogRead(botA1)>500){
    BUTTON_UP_PIN=1;
  }
  if(!(analogRead(botA1)>500)){
    BUTTON_UP_PIN=0;
  }
  if(analogRead(botA2)>500){
    BUTTON_DOWN_PIN=1;
  }
  if(!(analogRead(botA2)>500)){
    BUTTON_DOWN_PIN=0;
  }
}
void sensor(){
  digitalWrite(trig, HIGH);
  delay(1);
  digitalWrite(trig, LOW);
  duracion = pulseIn(eco, HIGH);
  distancia = (duracion/2)/29;
  Serial.println(distancia);
  delay(25);
  if (distancia<5){
    analogWrite(led1,1022);
    analogWrite(led2,1022);
    analogWrite(led3,1022);
    buzzer();
  }
  if (distancia>=5 && distancia<10){
    analogWrite(led1,1022);
    analogWrite(led2,1022);
    analogWrite(led3,0);
  }
  if (distancia>=10 && distancia<20){
    analogWrite(led1,1022);
    analogWrite(led2,0);
    analogWrite(led3,0);
  }
  if (distancia>=20){
    analogWrite(led1,0);
    analogWrite(led2,0);
    analogWrite(led3,0);
  }
}
void leds(){
  digtalWrite(led1,1);
  digtalWrite(led2,1);
  digtalWrite(led3,1);
  delay(50);
  digtalWrite(led1,0);
  digtalWrite(led2,0);
  digtalWrite(led3,0);
  delay(50);

}

void servo(){
  posicion_pot = analogRead(pot);
  
  angulo_servo = map(posicion_pot, 0, 1023, 0, 181);
  Serial.println(angulo_servo);
  servoMotor.write(angulo_servo);
  
}

void motores(){
  
  analogWrite(pwmD,255);
  analogWrite(pwmI,255);
  digitalWrite(dirD1, 0);
  digitalWrite(dirD2, 1);
  digitalWrite(dirI1, 1);
  digitalWrite(dirI2, 0);
  delay(2000);
  analogWrite(pwmD,150);
  analogWrite(pwmI,150);
  digitalWrite(dirD1, 1);
  digitalWrite(dirD2, 0);
  digitalWrite(dirI1, 0);
  digitalWrite(dirI2, 1);
  delay(2000);
  digitalWrite(dirD1, 0);
  digitalWrite(dirD2, 0);
  digitalWrite(dirI1, 0);
  digitalWrite(dirI2, 0);
  delay(2000);
}
